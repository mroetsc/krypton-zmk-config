## boards/shields/krypton/Kconfig.defconfig
```kconfig
if SHIELD_KRYPTON_LEFT

config ZMK_KEYBOARD_NAME
    default "Krypton-KBD"

config ZMK_SPLIT_ROLE_CENTRAL
    default y

endif

if SHIELD_KRYPTON_LEFT || SHIELD_KRYPTON_RIGHT

config ZMK_SPLIT
    default y

endif
```

## boards/shields/krypton/Kconfig.shield
```kconfig
config SHIELD_KRYPTON_LEFT
    def_bool $(shields_list_contains,krypton_left)

config SHIELD_KRYPTON_RIGHT
    def_bool $(shields_list_contains,krypton_right)
```
